## config/west.yml
```yaml
manifest:
  remotes:
    - name: zmkfirmware
      url-base: https://github.com/zmkfirmware
    - name: caksoylar
      url-base: https://github.com/caksoylar
    - name: xudongz
      url-base: https://github.com/xudongzheng
    - name: urob
      url-base: https://github.com/urob
  projects:
    - name: zmk
      remote: zmkfirmware
#      revision: fix-battery-reporting
#      revision: custom-wq-pr
      revision: main
      import: app/west.yml
  self:
    path: config
```
